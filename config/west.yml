## config/west.yml
```yaml
manifest:
  remotes:
    - name: cormoran
      url-base: https://github.com/cormoran
    - name: JimmyBlackley
      url-base: https://github.com/JimmyBlackley
  projects:
    - name: nice-view-dbz
      remote: JimmyBlackley
      revision: 698b8ee338a9f8c765d0d2da2356b6cb95ce1521
    - name: zmk
      remote: cormoran
      # Upstream's v0.3-branch+dya, pinned to the version validated here.
      revision: 4493783ef88ce2e653bf8217c92ee17140df71e3
      import: app/west.yml
    - name: zmk-module-ble-management
      remote: cormoran
      # zmk-v0.3.0.0
      revision: 851661cd21f2aded8ec649da86e01a207dc4b973
    - name: zmk-module-settings-rpc
      remote: cormoran
      revision: 78f86df9e6c5edaf57bef3ccbd7f360cfdf49291
  self:
    path: config
```
